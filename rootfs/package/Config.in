## rootfs/package/Config.in
```kconfig
menu "goodluckOS Custom Packages"
source "../package/imgui/Config.in"
source "../package/retroarch/Config.in"
source "../package/libretro-cores/Config.in"
source "../package/puppy/Config.in"
source "../package/ppsspp/Config.in"
source "../package/evsieve/Config.in"
source "../package/credits/Config.in"
source "../package/glos-setup/Config.in"
endmenu
```

## rootfs/package/gl-scrape/Config.in
```kconfig
config BR2_PACKAGE_GL_SCRAPE
	bool "gl-scrape"
	depends on BR2_INSTALL_LIBSTDCPP # C++ is required
	select BR2_PACKAGE_LIBCURL
	select BR2_PACKAGE_LIBCURL_CURL
	select BR2_PACKAGE_CA_CERTIFICATES
	help
	  Scrapes the ROM folders from ScreenScraper into their
	  gamelist.xml. It runs the curl program for HTTPS.
	  ScreenScraper's developer credentials come from SS_DEVID
	  and SS_DEVPASSWORD in the build's environment.

comment "gl-scrape needs a toolchain w/ C++"
	depends on !BR2_INSTALL_LIBSTDCPP
```

## rootfs/package/mesa3d-panfrost/Config.in
```kconfig
config BR2_PACKAGE_MESA3D_PANFROST
	bool "mesa3d panfrost"
	depends on BR2_PACKAGE_MESA3D
	select BR2_PACKAGE_MESA3D_GALLIUM_DRIVER
	help
	  Mesa's panfrost driver (Mali Midgard, Bifrost and Valhall, such
	  as the RK3326's Mali-G31) with no LLVM on the target.

	  Buildroot's own option builds LLVM and clang and installs them
	  on the target. Here Mesa's CL tools (mesa_clc, vtn_bindgen2,
	  panfrost_compile) are built with the build machine's LLVM 19.
	  On Debian: llvm-19-dev libclang-19-dev libclang-cpp19-dev
	  libclc-19-dev libllvmspirvlib-19-dev spirv-tools.
```
